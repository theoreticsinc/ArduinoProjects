#include <SPI.h>
#include <MFRC522.h>
#include <avr/wdt.h>
#include <avr/pgmspace.h>

#define RST_PIN         48
#define SS_PIN          53
#define SSR_PIN         44
#define BARRIER_DELAY   5000 // Time in ms to hold the barrier relay active

MFRC522 mfrc522(SS_PIN, RST_PIN);

// Master list stored in PROGMEM (Flash memory) as 4-byte raw hex arrays to save RAM
const byte PROGMEM masterList[][4] = {
    // SCRAP Cards
    {0x22, 0x3E, 0x5A, 0x6A}, {0xD6, 0xF1, 0xF2, 0x9C}, {0x49, 0xE5, 0x6D, 0x00}, {0xEA, 0x95, 0x11, 0xE6},
    {0x0A, 0x17, 0x22, 0xE6}, {0xFA, 0xC1, 0x80, 0xEA}, {0x0A, 0xD5, 0x29, 0xE6}, {0x5A, 0x67, 0x1F, 0xE6},
    {0xEA, 0x38, 0x5F, 0xEA}, {0x4A, 0xE9, 0x83, 0xEA}, {0x2A, 0x15, 0x26, 0xE6}, {0x1A, 0xBC, 0x0B, 0xE6},
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    {0xFA, 0x6D, 0x18, 0xE6}, {0x72, 0x0F, 0x98, 0x6A}, {0x02, 0x9F, 0xA3, 0x6A}, {0x62, 0xA3, 0x9C, 0x6A},

    // NEW Cards 201 - 230
    {0x16, 0x14, 0xC8, 0xB5}, {0x56, 0xB4, 0xA7, 0xB5}, {0xA6, 0xB1, 0xC5, 0xB5}, {0x86, 0x5E, 0xCA, 0xB5},
    {0x16, 0x58, 0xA7, 0xB5}, {0x56, 0x3E, 0xC3, 0xB5}, {0x76, 0xA5, 0xC5, 0xB5}, {0xA6, 0x89, 0xC5, 0xB5},
    {0xA6, 0x9E, 0xCA, 0xB5}, {0x46, 0x17, 0xB2, 0xB5}, {0x06, 0x6F, 0x06, 0x9D}, {0x26, 0x71, 0x30, 0xB6},
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    {0x66, 0xF4, 0xB2, 0xB5}, {0x63, 0x6F, 0x5D, 0x1C},

    // Nov 2025 231 - 280
    {0x3A, 0x9D, 0xD9, 0xE1}, {0x9A, 0xE6, 0xE1, 0xE1}, {0x0A, 0xAC, 0xDB, 0xE1}, {0x1A, 0xCA, 0xE0, 0xE1},
    {0xCA, 0xED, 0xDA, 0xE1}, {0x6A, 0xDC, 0xE6, 0xE1}, {0x1A, 0x8F, 0xE4, 0xE1}, {0x5A, 0x0A, 0xD9, 0xE1},
    {0x3A, 0x7C, 0xD8, 0xE1}, {0x4A, 0xB7, 0xDC, 0xE1}, {0x2A, 0xF5, 0xD8, 0xE1}, {0xBE, 0xE6, 0x8E, 0xF5},
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    {0x8E, 0x29, 0x94, 0xF5}, {0xEE, 0x12, 0x9C, 0xF5},

    // 281 - 330 (Oct 2026 Batch)
    {0x01, 0x92, 0x19, 0x95}, {0x31, 0xDF, 0x26, 0x95}, {0x41, 0xDF, 0x26, 0x95}, {0x11, 0xCE, 0xF7, 0x96},
    {0x91, 0x20, 0x21, 0x95}, {0x31, 0x69, 0xF4, 0x96}, {0x11, 0x9D, 0xF9, 0x96}, {0xD1, 0x9C, 0xF9, 0x96},
    {0x81, 0xE4, 0xF6, 0x96}, {0xA1, 0xB2, 0xF7, 0x96}, {0x71, 0xDB, 0xF6, 0x96}, {0xA1, 0xF6, 0x89, 0x60},
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    {0x51, 0xB0, 0x56, 0xA9}, {0xD1, 0xD6, 0x39, 0xA9}
};

const int masterListSize = sizeof(masterList) / sizeof(masterList[0]);

void setup() {
  Serial.begin(115200);
  
  // Enable Watchdog timer with a 2-second timeout interval
  wdt_enable(WDTO_2S);

  pinMode(SSR_PIN, OUTPUT);
  digitalWrite(SSR_PIN, LOW); // Barrier defaults to closed

  SPI.begin();
  mfrc522.PCD_Init();
  
  // Set antenna gain to maximum sensitivity
  mfrc522.PCD_SetAntennaGain(mfrc522.RxGain_max);

  Serial.println(F("\n--- System Ready ---"));
  Serial.println(F("Waiting for RFID Cards..."));
}

void loop() {
  // Feed watchdog timer
  wdt_reset();

  // Look for new card
  if (!mfrc522.PICC_IsNewCardPresent() || !mfrc522.PICC_ReadCardSerial()) {
    return;
  }

  // Print raw UID
  Serial.print(F("UID: "));
  printUID(mfrc522.uid.uidByte, mfrc522.uid.size);

  // Validate UID
  if (isAuthorized(mfrc522.uid.uidByte, mfrc522.uid.size)) {
    Serial.println(F(" : AUTH -> Barrier Open"));
    openBarrier();
  } else {
    Serial.println(F(" : UNREGD -> Denied"));
  }

  // Halt card reading
  mfrc522.PICC_HaltA();
  mfrc522.PCD_StopCrypto1();
}

bool isAuthorized(byte* scannedUid, byte size) {
  if (size != 4) return false; // This list checks standard 4-byte UIDs

  for (int i = 0; i < masterListSize; i++) {
    bool match = true;
    for (byte j = 0; j < 4; j++) {
      byte flashByte = pgm_read_byte(&(masterList[i][j]));
      if (scannedUid[j] != flashByte) {
        match = false;
        break;
      }
    }
    if (match) return true;
  }
  return false;
}

void printUID(byte* uidBytes, byte size) {
  for (byte i = 0; i < size; i++) {
    if (uidBytes[i] < 0x10) {
      Serial.print(F("0"));
    }
    Serial.print(uidBytes[i], HEX);
  }
}

void openBarrier() {
  digitalWrite(SSR_PIN, HIGH);
  
  // Maintain relay output while feeding the Watchdog Timer
  unsigned long startTime = millis();
  while (millis() - startTime < BARRIER_DELAY) {
    wdt_reset();
  }
  
  digitalWrite(SSR_PIN, LOW);
}